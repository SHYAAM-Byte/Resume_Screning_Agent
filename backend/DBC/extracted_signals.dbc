VERSION ""

NS_ :

BS_:

BU_:

BO_ 416 CAN_1A0: 8 Vector__XXX
 SG_ B1_Counter : 0|8@1+ (1,0) [1|7] "" Vector__XXX

BO_ 688 CAN_2B0: 8 Vector__XXX
 SG_ B1_Counter : 0|8@1+ (1,0) [0|15] "" Vector__XXX
